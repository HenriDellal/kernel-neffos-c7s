/ { lcds {
	lcd_st7796s_mipi_hvga: lcd7796@7796 {

		work-mode = <1>;
		bpp = <24>;
		lane-number = <1>;

		need-check-esd = <0>;
		esd-timeout = <1000>;

		fps = <60>;
		width-mm = <34>;
		height-mm = <60>;
		panel-name = "lcd_st7796s_mipi_hvga";

		power-on-sequence = <
					50  1  5
					50  0  5
					50  1  20
					>;
		power-off-sequence = <
					50  0  20
					>;

		init-data = [
			23 00 00 02 36 4C
			23 00 00 02 3A 77
			23 00 00 02 F0 C3
			23 00 00 02 F0 96
			23 00 00 02 B0 80
			23 00 00 02 B4 01
			23 00 00 05 B5 0A 14 00 0A
			23 00 00 04 B6 B0 02 3B
			23 00 00 02 B7 C6
			23 00 00 09 E8 40 8A 00 00 29 19 A5 33
			23 00 00 03 C0 80 60
			23 00 00 02 C1 18
			23 00 00 02 C2 A7
			23 00 00 02 C5 13
			23 00 00 0F E0 A0 17 1E 0C 0D 29 40 63 50 19 16 12 20 22
			23 00 00 0F E1 A0 16 1E 0C 0D 28 40 3D 50 1A 16 12 20 24
			23 00 00 02 F0 3C
			23 00 00 02 F0 69
			23 78 00 02 11 00
			23 0A 00 02 29 00
			];
		sleep-in = [
			13 0A 00 01 28
			13 78 00 01 10
			];
		sleep-out = [
			13 78 00 01 11
			13 64 00 01 29
			];

		display-timings {
			clock-frequency = <300000>;
			hactive = <320>;
			vactive = <480>;
			hback-porch = <20>;
			hfront-porch = <28>;
			vback-porch = <4>;
			vfront-porch = <8>;
			hsync-len = <10>;
			vsync-len = <4>;
		};
	};
};};

