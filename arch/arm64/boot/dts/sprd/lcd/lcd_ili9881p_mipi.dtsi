/ { lcds {
	lcd_ili9881p_mipi: lcd988110@988110 {

		work-mode = <1>;
		bpp = <24>;
		lane-number = <3>;

		need-check-esd = <3>;
		esd-timeout = <2000>;
		esd-check-reg = <0x0A>;
		esd-return-code = <0x9C>;

		//specificode = <2000>;
		
		fps = <60>;
		width-mm = <62>;
		height-mm = <124>;
		panel-name = "lcd_ili9881p_mipi";
		
		lcd-glass = "PANDA";
		lcd-module = "COE";
		lcd-name = "ILI9881P";
		
		power-on-sequence = <
					4  1  5
					5  1  5  
					50  1  10
					50  0  5
					50  1  100 // WRW0929
					>;
		power-off-sequence = <
					50  0  5
					5  0  5
					4  0  5 
					>;

		init-data = [

			39 00 00 04  FF 98 81 05
			23 00 00 02 B2 70
		//	23 00 00 02 03 00
		//	23 00 00 02 04 24
			23 00 00 02 30 F7
			23 00 00 02 29 00
			23 00 00 02 2A 12
			23 00 00 02 38 A8
			23 00 00 02 1A 50
			23 00 00 02 52 5F
			23 00 00 02 54 28
			23 00 00 02 55 25

			23 00 00 02 26 02
			23 00 00 02 3D A1
			23 00 00 02 1B 01

			39 00 00 04  FF 98 81 02
			23 00 00 02 42 2F
			23 00 00 02 01 50
			23 00 00 02 15 10

			23 00 00 02 57 00
			23 00 00 02 58 22
			23 00 00 02 59 31
			23 00 00 02 5A 15
			23 00 00 02 5B 18
			23 00 00 02 5C 2B
			23 00 00 02 5D 1F
			23 00 00 02 5E 20
			23 00 00 02 5F 98
			23 00 00 02 60 1D
			23 00 00 02 61 29
			23 00 00 02 62 7F
			23 00 00 02 63 19
			23 00 00 02 64 16
			23 00 00 02 65 4A
			23 00 00 02 66 20
			23 00 00 02 67 26
			23 00 00 02 68 4D
			23 00 00 02 69 5B
			23 00 00 02 6A 25

			23 00 00 02 6B 00
			23 00 00 02 6C 22
			23 00 00 02 6D 31
			23 00 00 02 6E 15
			23 00 00 02 6F 18
			23 00 00 02 70 2B
			23 00 00 02 71 1F
			23 00 00 02 72 20
			23 00 00 02 73 98
			23 00 00 02 74 1D
			23 00 00 02 75 29
			23 00 00 02 76 7F
			23 00 00 02 77 19
			23 00 00 02 78 16
			23 00 00 02 79 4A
			23 00 00 02 7A 20
			23 00 00 02 7B 26
			23 00 00 02 7C 4D
			23 00 00 02 7D 5B
			23 00 00 02 7E 25

			39 00 00 04  FF 98 81 01
			23 00 00 02 01 00
			23 00 00 02 02 00
			23 00 00 02 03 56
			23 00 00 02 04 13
			23 00 00 02 05 13
			23 00 00 02 06 0a
			23 00 00 02 07 05
			23 00 00 02 08 05
			23 00 00 02 09 1D
			23 00 00 02 0a 01
			23 00 00 02 0b 00
			23 00 00 02 0c 3F
			23 00 00 02 0d 29
			23 00 00 02 0e 29
			23 00 00 02 0f 1D
			23 00 00 02 10 1D
			23 00 00 02 11 00
			23 00 00 02 12 00
			23 00 00 02 13 08
			23 00 00 02 14 08
			23 00 00 02 15 00
			23 00 00 02 16 00
			23 00 00 02 17 00
			23 00 00 02 18 00
			23 00 00 02 19 00
			23 00 00 02 1a 00
			23 00 00 02 1b 00
			23 00 00 02 1c 00
			23 00 00 02 1d 00
			23 00 00 02 1e 40
			23 00 00 02 1f 88
			23 00 00 02 20 08
			23 00 00 02 21 01
			23 00 00 02 22 00
			23 00 00 02 23 00
			23 00 00 02 24 00
			23 00 00 02 25 00
			23 00 00 02 26 00
			23 00 00 02 27 00
			23 00 00 02 28 33
			23 00 00 02 29 03
			23 00 00 02 2a 00
			23 00 00 02 2b 00
			23 00 00 02 2c 00
			23 00 00 02 2d 00
			23 00 00 02 2e 00
			23 00 00 02 2f 00
			23 00 00 02 30 00
			23 00 00 02 31 00
			23 00 00 02 32 00
			23 00 00 02 33 00
			23 00 00 02 34 00
			23 00 00 02 35 00
			23 00 00 02 36 00
			23 00 00 02 37 00
			23 00 00 02 38 00
			23 00 00 02 39 0f
			23 00 00 02 3a 2a
			23 00 00 02 3b c0
			23 00 00 02 3c 00
			23 00 00 02 3d 00
			23 00 00 02 3e 00
			23 00 00 02 3f 00
			23 00 00 02 40 00
			23 00 00 02 41 e0
			23 00 00 02 42 40
			23 00 00 02 43 0f
			23 00 00 02 44 31
			23 00 00 02 45 a8
			23 00 00 02 46 00
			23 00 00 02 47 08
			23 00 00 02 48 00
			23 00 00 02 49 00
			23 00 00 02 4a 00
			23 00 00 02 4b 00

			23 00 00 02 4c b2
			23 00 00 02 4d 22
			23 00 00 02 4e 01
			23 00 00 02 4f f7
			23 00 00 02 50 29
			23 00 00 02 51 72
			23 00 00 02 52 25
			23 00 00 02 53 b2
			23 00 00 02 54 22
			23 00 00 02 55 22
			23 00 00 02 56 22

			23 00 00 02 57 a2
			23 00 00 02 58 22
			23 00 00 02 59 01
			23 00 00 02 5a e6
			23 00 00 02 5b 28
			23 00 00 02 5c 62
			23 00 00 02 5d 24
			23 00 00 02 5e a2
			23 00 00 02 5f 22
			23 00 00 02 60 22
			23 00 00 02 61 22

			23 00 00 02 62 ee

			23 00 00 02 63 02
			23 00 00 02 64 0b
			23 00 00 02 65 02
			23 00 00 02 66 02
			23 00 00 02 67 01
			23 00 00 02 68 00
			23 00 00 02 69 0f
			23 00 00 02 6a 07
			23 00 00 02 6b 55
			23 00 00 02 6c 02
			23 00 00 02 6d 02
			23 00 00 02 6e 5b
			23 00 00 02 6f 59
			23 00 00 02 70 02
			23 00 00 02 71 02
			23 00 00 02 72 57
			23 00 00 02 73 02
			23 00 00 02 74 02
			23 00 00 02 75 02
			23 00 00 02 76 02
			23 00 00 02 77 02
			23 00 00 02 78 02

			23 00 00 02 79 02
			23 00 00 02 7a 0a
			23 00 00 02 7b 02
			23 00 00 02 7c 02
			23 00 00 02 7d 01
			23 00 00 02 7e 00
			23 00 00 02 7f 0e
			23 00 00 02 80 06
			23 00 00 02 81 54
			23 00 00 02 82 02
			23 00 00 02 83 02
			23 00 00 02 84 5a
			23 00 00 02 85 58
			23 00 00 02 86 02
			23 00 00 02 87 02
			23 00 00 02 88 56
			23 00 00 02 89 02
			23 00 00 02 8a 02
			23 00 00 02 8b 02
			23 00 00 02 8c 02
			23 00 00 02 8d 02
			23 00 00 02 8e 02

			23 00 00 02 8f 44
			23 00 00 02 90 44

			39 00 00 04  FF 98 81 06
			23 00 00 02 01 03
			23 00 00 02 04 71
			23 00 00 02 2B 0A

			23 00 00 02 C0 CF
			23 00 00 02 C1 2A

			39 00 00 04  FF 98 81 00
			
			23 00 00 02 35 00
			23 00 00 02 36 00
			
			23 78 00 02 11 00
			23 14 00 02 29 00

			];
		sleep-in = [
			13 14 00 01 28
			13 78 00 01 10
			];
		sleep-out = [
			13 78 00 01 11
			13 14 00 01 29
			];

		display-timings {
			clock-frequency = <690000>;
			hactive = <720>;
			vactive = <1440>;
			hback-porch = <60>;
			hfront-porch = <60>;
			vback-porch = <20>;
			vfront-porch = <20>;
			hsync-len = <20>;
			vsync-len = <8>;
		};	
	};
};};
