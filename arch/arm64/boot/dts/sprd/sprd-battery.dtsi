/*
* Copyright (C) 2015 Spreadtrum Communication Incorporated
*		http://www.spreadtrum.com/
*
* This program is free software; you can redistribute it and/or modify
* it under the terms of the GNU General Public License version 2 as
* published by the Free Software Foundation.
*/

/* This is the sprd battery default DTS */
/{
	battery: battery {
		compatible = "sprd,sprd-battery";
		status = "disabled";
		battery-adapt-support = <0>;
		battery-adapt-fun = <0>;
		chg-end-vol = <4370>;
		chg-end-vol-check = <4330>;
		chg-bat-safety-vol = <4430>;
		fchg-vol = <9000>;
		rechg-vol = <4310>;
		adp-cdp-cur = <1000>;
		adp-dcp-cur = <1000>;
		adp-sdp-cur = <500>;
		adp-unknown-cur = <500>;
		adp-fchg-cur = <3000>;
		adp-cdp-cur-limit = <1500>;
		adp-dcp-cur-limit = <3000>;
		adp-sdp-cur-limit = <500>;
		adp-fchg-cur-limit = <2000>;
		adp-unknown-cur-limit = <500>;
		ovp-stop = <5700>;
		ovp-restart = <5400>;
		fchg-ovp-stop = <11000>;
		fchg-ovp-restart = <10000>;
		chg-timeout = <57600>;
		chg-rechg-timeout = <57600>;
		chg-end-cur = <90>;
		chg-polling-time = <15>;
		chg-polling-time-fast = <1>;
		cap-one-per-time = <30>;
		/*0 vol and cur,1 status and cur,2 ext ic*/
		chg-full-condition = <0>;
		temp-support = <1>;
		/*30mohm,if temp-table-mode = <1>, use it*/
		temp-comp-res = <56>;
		temp-tab-val = <1206 1094 989 884 777 675
				590 512 448 376 325 269
				240 209 178 145 128 111 96 84 73>;
		/* temperature + 1000,750 = 1000 + (-250)*/
		temp-tab-temp = <750 800 850 900 950 1000
				 1050 1100 1150 1200 1250 1300
				 1350 1400 1450 1500 1550 1600 1650 1700 1750>;
		jeita-temp-tab = <1000 1100 1400 1450 1550>;
		jeita-temp-recovery-tab = <1020 1120 1400 1450 1500>;
		jeita-cur-tab = <0 600 1000 1000 600 0>;
		jeita-cccv-tab = <4370 4370 4370 4370 4200 4200>;
		only-vol-mode = <0>;
		fgu-mode = <0>;
		alm-soc = <5>;
		alm-vol = <3500>;
		soft-vbat-uvlo = <3100>;
		rint = <280>;
		cnom = <2500>;
		rsense-psc5415a = <1>;/*0:56mohm; 1:33mohm*/
		rsense-real = <102>;
		rsense-spec = <200>;
		relax-current = <50>;
		fgu-cal-ajust = <0>;
		ocv-tab-vol = <4320 4253 4197 4145 4095 4054 3989
			3962 3925 3877 3841 3817 3799 3786
			3779 3773 3758 3738 3698 3642 3400>;
		ocv-tab-cap = <100 95 90 85 80 75 70 65 60 55
					   50 45 40 35 30 25 20 15 10 5 0>;
		charge-vol-tab = <4180 4130 4100 4060 4030 4000 3959
			3930 3904 3880 3860 3840 3830 3810
			3790 3780 3730 3690 3565 3510 3400>;
		charge-vol-tab-cap = <100 95 90 85 80
			75 70 65 60 55 50 45 40 35 30 25
			20 15 10 5 0>;
		discharge-vol-tab = <4150 4100 4050 4020 4000 3970 3940
			3910 3880 3850 3820 3790 3770 3755
			3750 3715 3680 3650 3600 3510 3400>;
		discharge-vol-tab-cap = <100 95 90 85 80
			75 70 65 60 55 50 45 40 35 30 25
			20 15 10 5 0>;
		cnom-temp-tab = <1020 1800	/*value = 1000 + temp*/
				1010 1300
				1000 1070
				990  1000>;
		rint-temp-tab = <1020 200	/*value = 1000 + temp*/
				1010 450
				1000 650
				990  1100>;
		};
};

