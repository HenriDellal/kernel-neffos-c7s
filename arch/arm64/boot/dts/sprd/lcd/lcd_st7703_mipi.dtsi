/ { lcds {
	lcd_st7703_mipi: lcd38211f@38211f {

		work-mode = <1>;
		bpp = <24>;
		lane-number = <3>;

		need-check-esd = <0>;
		esd-timeout = <2000>;
		esd-check-reg = <0x0A>;
		esd-return-code = <0x1C>;

		//specificode = <2000>;
		
		fps = <60>;
		width-mm = <59>;
		height-mm = <124>;
		panel-name = "lcd_st7703_mipi";
		
		power-on-sequence = <
					4  1  5
					5  1  5  
					50  1  10
					50  0  5
					50  1  100 // WRW0929
					>;
		power-off-sequence = <
					5  0  5
					50  0  5
					4  0  5 
					>;

		init-data = [
		39 00 00 04 B9 F1 12 83 
		39 00 00 1C BA 32 81 05 F9 0e 0e 20 00 00 00 00 00 00 00 44 25 00 91 0a 00 00 02 4F 11 00 00 37 
		39 00 00 05 B8 76 22 20 03 
		39 00 00 0B B3 10 10 05 05 03 FF 00 00 00 00 
		39 00 00 0A C0 70 73 50 50 C0 00 08 70 00 //5&6th 00 00 ->C0 C0
		23 00 00 02 BC 4E	
		23 00 00 02 CC 0B
		23 00 00 02 B4 80 
		39 00 00 04 B1 00 00 01//add	
		39 00 00 04 B2 A3 15 F0 
		39 00 00 0F E3 07 07 0B 0B 10 10 00 00 00 00 28 00 C0 10 //5&6th 03 0B->10 10 11th FF->28
		39 00 00 0D C1 54 00 1E 1E 77 F1 FF FF EE EE EE EE //7~12th CC CC 77 77->EE EE EE EE
		39 00 00 03 C6 01 40//add
		39 00 00 03 B5 0C 0C
		39 00 00 03 B6 23 23
		39 00 00 04 BF 02 11 00 
		39 00 00 40 E9 C2 10 07 04 6A 97 A0 12 31 23 47 84 97 A0 37 38 0C 00 18 00 00 00 0C 00 18 00 00 00 88 87 57 53 18 88 88 88 88 13 88 88 86 46 42 08 88 88 88 88 02 88 00 00 00 00 00 00 00 00 00 00 00 00 00 
		39 00 00 3E EA 02 21 00 00 00 00 00 00 00 00 00 00 88 80 20 24 68 88 88 88 88 64 88 88 81 31 35 78 88 88 88 88 75 88 23 00 00 00 08 00 00 00 00 00 00 00 00 00 00 00 00 00 00 00 40 97 A0 00 00 00 00 
		39 00 00 23 E0 00 0E 16 25 27 3A 4C 3C 08 0D 0F 12 13 11 13 16 19 00 0E 16 25 27 3A 4C 3C 08 0D 0F 12 13 11 13 16 19 				        
		23 00 00 02 C7 B0//10->b0
		23 00 00 02 51 80//add
		23 00 00 02 53 24//add		
		13 FA 00 01 11		    
		13 32 00 01 29 
			];
		sleep-in = [
			13 32 00 01 28      //SET 50MS
			13 78 00 01 10     //SET 120MS
			];
		sleep-out = [
			13 78 00 01 11
			13 32 00 01 29
			];

		display-timings {
			clock-frequency = <600000>;
			hactive = <540>;
			vactive = <1132>;
			hback-porch = <69>;/*<30>;*/
			hfront-porch = <69>;/*<80>;*/
			vback-porch = <9>;/*<8>;*/
			vfront-porch = <15>;/*<36>;*/
			hsync-len = <56>;
			vsync-len = <4>;/*<4>;*/
		};
	};
};};
