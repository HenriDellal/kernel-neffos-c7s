/*
 * Spreadtrum sharkl3 sp9863a board DTS file
 *
 * Copyright (C) 2018, Spreadtrum Communications Inc.
 *
 * This file is licensed under a dual GPLv2 or X11 license.
 */
/dts-v1/;
/plugin/;


/ {
	/*
	* When create a new node, we should use the key word __overlay__,
	* otherwise u-boot can not analyze it.
	*/

	fragment {
		target-path = "/";
		__overlay__ {
			sprd_overlay {
				compatible = "sprd,overlay";
				string = "spreadtrum overlay test!";
			};
		};
	};
};

/*
 * Sample code. Google strongly recommends you do not use fragment@x and
 * syntax __overlay__, and instead use the reference syntax
 */
&memory {
	compatible = "sprd,memory-dtbo";
};

&ddr_dfs {
	sprd-scene = "boost", "lcdon", "lcdoff", "camlow",
		"camhigh", "camveryhigh";
	sprd-freq = <933 400 233 400 622 933>;
	overflow = <448000 652400 870800 960000 1492400 1741600 2240000 8000000>;
	underflow = <0 348000 552400 770800 860000 860000 1641600 2140000>;
};
