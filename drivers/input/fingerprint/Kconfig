## drivers/input/fingerprint/Kconfig
```kconfig
menuconfig INPUT_FINGERPRINT
	bool "Fingerprint"
	help
	  Say Y here, and a list of supported fingerprint(s) will be displayed.
	  This option doesn't affect the kernel.

source "drivers/input/fingerprint/betterlife_fp/Kconfig"
source "drivers/input/fingerprint/sunwave/Kconfig"
```

## drivers/input/fingerprint/betterlife_fp/Kconfig
```kconfig
if INPUT_FINGERPRINT
config BETTERLIFE_FINGERPRINT
	tristate "betterlife FP spi deriver"
	depends on SPI_MASTER
	help
	  Say Y here to use silead fingerprint driver.
endif
```

## drivers/input/touchscreen/focaltech_tp/Kconfig
```kconfig
#
# Focaltech Touchscreen driver configuration
#

config TOUCHSCREEN_FOCALTECH_TP
        bool "Focaltech Tp Touchscreen"
		depends on I2C
		default n
		help
		  Say Y here if you have Focaltech tp panel.
		  If unsure, say N.

config TOUCHSCREEN_FTS_DIRECTORY
    string "Focaltech ts directory name"
    default "focaltech_tp"
    depends on TOUCHSCREEN_FOCALTECH_TP
    
```
