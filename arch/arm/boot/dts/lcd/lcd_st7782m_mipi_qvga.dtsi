/ { lcds {
	lcd_st7782m_mipi_qvga: lcd7782@7782 {

		work-mode = <1>;
		bpp = <24>;
		lane-number = <1>;

		need-check-esd = <0>;
		esd-timeout = <1000>;

		fps = <60>;
		width-mm = <34>;
		height-mm = <60>;
		panel-name = "lcd_st7782m_mipi_qvga";

		power-on-sequence = <
					50  1  5
					50  0  5
					50  1  20
					>;
		power-off-sequence = <
					50  0  20
					>;

		init-data = [
			23 00 00 02 F0 C3
			23 00 00 02 F0 96
			23 00 00 02 F0 A5
			23 00 00 02 E9 20
			23 00 00 02 E7 83
			23 00 00 05 C3 44 02 77 01
			23 00 00 05 C4 66 06 66 01
			23 00 00 02 ED C3
			23 00 00 04 E4 40 00 00
			23 00 00 0F E5 9A f5 95 57 22 25 01 22 22 22 22 22 22 22
			23 00 00 0F E6 9A f5 95 85 22 25 21 33 33 33 33 33 33 33
			23 00 00 08 EC 00 55 03 00 00 49 22
			23 00 00 05 C1 00 0A AC 11
			23 00 00 05 C2 00 0A AC 11
			23 00 00 02 36 04
			23 00 00 02 3A 07
			23 00 00 02 C5 41
			23 00 00 0F E0 F0 04 13 0F 12 0A 41 44 50 3A 16 15 20 22
			23 00 00 0F E1 F0 04 14 0F 12 0A 41 44 50 3A 16 15 1F 22
			23 00 00 03 B1 F5 A9
			23 00 00 02 B2 10
			23 00 00 02 B3 02
			23 00 00 02 B4 00
			23 00 00 05 B5 00 54 00 54
			23 00 00 0A A5 20 12 f0 01 00 0a 2A 0A 02
			23 00 00 0A A6 20 12 40 01 00 11 2A 0A 03
			23 00 00 08 BA 59 02 03 00 22 02 00
			23 00 00 09 BB 00 35 00 35 88 8B 0B 00
			23 00 00 08 BC 00 79 00 79 88 8B 0B
			23 00 00 0C BD 44 FF FF FF 15 51 FF FF 87 FF 02
			23 00 00 02 D9 E2
			23 78 00 01 11
			23 78 00 01 29
			];
		sleep-in = [
			13 0A 00 01 28
			13 78 00 01 10
			];
		sleep-out = [
			13 78 00 01 11
			13 64 00 01 29
			];

		display-timings {
			clock-frequency = <300000>;
			hactive = <240>;
			vactive = <320>;
			hback-porch = <80>;
			hfront-porch = <80>;
			vback-porch = <4>;
			vfront-porch = <4>;
			hsync-len = <20>;
			vsync-len = <1>;
		};
	};
};};

